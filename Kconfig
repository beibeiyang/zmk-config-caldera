## Kconfig
```kconfig
DT_COMPAT_ZMK_MIN_SPLIT_BATTERY := zmk,min-split-battery

config ZMK_MIN_SPLIT_BATTERY
    bool "Report minimum battery level from split halves to host"
    default $(dt_compat_enabled,$(DT_COMPAT_ZMK_MIN_SPLIT_BATTERY))
    depends on ZMK_BATTERY_REPORTING
```

## dts/bindings/zmk,min-split-battery.yaml
```yaml
description: >
  Virtual battery sensor that reports the minimum state-of-charge across
  both halves of a split keyboard. Place only in the central (left) overlay.

compatible: "zmk,min-split-battery"

include: base.yaml

properties:
  source:
    type: phandle
    required: true
    description: The real hardware battery sensor to read local SOC from.
```
