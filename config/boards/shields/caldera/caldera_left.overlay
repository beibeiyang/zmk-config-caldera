/*
 * Copyright (c) 2024 The ZMK Contributors
 *
 * SPDX-License-Identifier: MIT
 */

#include "caldera.dtsi"

&kscan0 {
    col-gpios
        = <&pro_micro 3 GPIO_ACTIVE_HIGH>
        , <&pro_micro 4 GPIO_ACTIVE_HIGH>
        , <&pro_micro 5 GPIO_ACTIVE_HIGH>
        , <&pro_micro 6 GPIO_ACTIVE_HIGH>
        , <&pro_micro 7 GPIO_ACTIVE_HIGH>
        /* P0.17 (pro_micro 2 / D2) is a dead pin on this Nice!Nano.
         * Hard-wired reroute: use P1.07 directly instead. */
        , <&gpio1 7 GPIO_ACTIVE_HIGH>
        ;
};
